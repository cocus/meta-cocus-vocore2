## conf/distro/vocore2.conf
```bitbake
require conf/distro/poky.conf

DISTRO = "vocore2"
DISTRO_NAME = "Vocore2 yocto distro"
DISTRO_VERSION = "2.0.0"

DISTRO_FEATURES:append = " wifi ipv4"


# Not using sysvinit :)
### VIRTUAL-RUNTIME_dev_manager = "busybox-mdev"
### VIRTUAL-RUNTIME_login_manager = "busybox"
### VIRTUAL-RUNTIME_init_manager = "busybox"
### VIRTUAL-RUNTIME_initscripts = "initscripts"
### VIRTUAL-RUNTIME_keymaps = "keymaps"
### DISTRO_FEATURES_BACKFILL_CONSIDERED += "sysvinit"

DISTRO_FEATURES:append = " systemd"
VIRTUAL-RUNTIME_init_manager = " systemd"
DISTRO_FEATURES_BACKFILL_CONSIDERED = "sysvinit"
VIRTUAL-RUNTIME_initscripts = "systemd-compat-units"

BAD_RECOMMENDATIONS += "udev-hwdb"
```

## conf/layer.conf
```bitbake
# We have a conf and classes directory, add to BBPATH
BBPATH =. "${LAYERDIR}:"

# We have recipes-* directories, add to BBFILES
BBFILES += "${LAYERDIR}/recipes-*/*/*.bb \
            ${LAYERDIR}/recipes-*/*/*.bbappend"

BBFILE_COLLECTIONS += "cocus-vocore2"
BBFILE_PATTERN_cocus-vocore2 = "^${LAYERDIR}/"
BBFILE_PRIORITY_cocus-vocore2 = "5"

LAYERSERIES_COMPAT_cocus-vocore2 = "kirkstone"

# This should only be incremented on significant changes that will
# cause compatibility issues with other layers
LAYERVERSION_cocus-vocore2 = "3"

LAYERDEPENDS_cocus-vocore2 = "core"

REQUIRED_POKY_BBLAYERS_CONF_VERSION = "2"
```

## conf/machine/vocore2.conf
```bitbake
#@TYPE: Machine
#@NAME: vocore2
#@SOC: Mediatek MT7628
#@DESCRIPTION: VoCore board using Mediatek MT7628
#@MAINTAINER: Santiago Hormazabal <santiagohssl@gmail.com>

require conf/machine/include/mips/tune-mips-24k.inc

DEFAULTTUNE = "mips32r2-24kec"

# Little Endian
TUNE_FEATURES:tune-mips-nf = "o32"

MACHINE_FEATURES = "usbhost serial wifi"
SERIAL_CONSOLES = "115200;ttyS2"

USE_VT ?= "0"

UBOOT_LOADADDRESS = "0x80000000"
UBOOT_ENTRYPOINT = "0x80000000"

FIT_KERNEL_COMP_ALG = "lzma"

KEEPUIMAGE="no"

KERNEL_IMAGETYPE = "uImage"
KERNEL_ALT_IMAGETYPE = "vmlinux.bin"
KERNEL_IMAGE_STRIP_EXTRA_SECTIONS  = ".comment"


PREFERRED_PROVIDER_virtual/kernel ?= "linux-mediatek"
PREFERRED_VERSION_linux-mediatek ?= "5.10%"

MACHINE_ESSENTIAL_EXTRA_RDEPENDS = "kernel kernel-modules"

SDCARD_ROOTFS ?= "${IMGDEPLOYDIR}/${IMAGE_NAME}.rootfs.ext4"
IMAGE_FSTYPES ?= "ext4"
```
